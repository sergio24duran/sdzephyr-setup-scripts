## CMakeLists.txt
```
# ---------------------------------------------------------------------------
# CMakeLists.txt - Multithreaded LED Example
# ---------------------------------------------------------------------------
# This project has multiple source files, one per thread. Each file
# implements a thread entry function. CMake compiles them all and links
# them into a single firmware image.
# ---------------------------------------------------------------------------

cmake_minimum_required(VERSION 3.20.0)

find_package(Zephyr REQUIRED HINTS $ENV{ZEPHYR_BASE})
project(multithreads_hello_leds)

# All source files are compiled together into one binary.
# In Zephyr, threads share the same address space (no process isolation),
# so functions defined in one file can be called from another.
target_sources(app PRIVATE
    src/main.c
    src/led_a_thread.c
    src/led_b_thread.c
)
```

## Kconfig
```
# Copyright (c) 2024 SDZephyr
# SPDX-License-Identifier: Apache-2.0

# ---------------------------------------------------------------------------
# Kconfig for the Multithreaded LED Example
# ---------------------------------------------------------------------------
# This example demonstrates core RTOS multithreading concepts:
#   - Thread creation with K_THREAD_DEFINE
#   - Thread priorities and how the scheduler picks which thread runs
#   - Semaphores for inter-thread synchronization
#   - Stack size configuration
#
# All timing and pin settings are configurable via Kconfig so you can
# experiment without modifying source code. Just edit prj.conf and rebuild!
#
# IMPORTANT: This file is the root Kconfig for the application. It MUST
# source "Kconfig.zephyr" to make all Zephyr symbols (GPIO, LOG, etc.)
# available. Without this, any reference to Zephyr symbols in prj.conf or
# via "select" will fail with "undefined symbol" errors.
# ---------------------------------------------------------------------------

mainmenu "Multithreaded LEDs Example"

# Pull in the full Zephyr Kconfig tree before our app-specific options.
source "Kconfig.zephyr"

menuconfig MULTITHREAD_LEDS
	bool "Multithreaded LEDs Example Configuration"
	default y
	help
	  Enable configuration options for the multithreaded LED example.

if MULTITHREAD_LEDS

# --- Thread stack sizes ---

config LED_THREAD_STACK_SIZE
	int "Stack size for each LED thread (bytes)"
	default 1024
	range 512 4096
	help
	  Each thread gets its own stack. If a thread uses too much stack
	  (deep call chains, large local variables), it will overflow and
	  crash. Zephyr can detect this at runtime if CONFIG_THREAD_STACK_GUARD
	  is enabled. 1024 bytes is sufficient for simple GPIO + logging.

# --- Thread priorities ---
# In Zephyr, LOWER number = HIGHER priority (for preemptive threads).
# Cooperative threads use negative priorities.
# Preemptive threads (priority >= 0) can be interrupted by higher-priority threads.

config LED_A_PRIORITY
	int "Priority for LED A thread"
	default 5
	range 0 15
	help
	  Thread priority for LED A. Lower number = higher priority.
	  If LED A has higher priority than LED B, it will be scheduled first
	  when both are ready to run. Since both threads spend most of their
	  time sleeping, priority differences mainly affect which thread
	  runs first when both wake up at the same instant.

config LED_B_PRIORITY
	int "Priority for LED B thread"
	default 7
	range 0 15
	help
	  Thread priority for LED B. A higher number (lower priority) means
	  this thread yields to LED A when both compete for CPU time.
	  Try setting both threads to the same priority to see round-robin
	  scheduling in action.

# --- Blink intervals ---

config LED_A_BLINK_INTERVAL_MS
	int "LED A blink interval (ms)"
	default 500
	range 100 10000
	help
	  How often LED A toggles. A different interval from LED B creates
	  a visually distinct blinking pattern, making it easy to confirm
	  that both threads are running independently.

config LED_B_BLINK_INTERVAL_MS
	int "LED B blink interval (ms)"
	default 1000
	range 100 10000
	help
	  How often LED B toggles. Set this to a different value from LED A
	  to clearly see independent thread execution.

# --- GPIO pins ---

config LED_A_GPIO_PIN
	int "GPIO pin for LED A"
	default 14
	help
	  GPIO pin number where LED A is connected.

config LED_B_GPIO_PIN
	int "GPIO pin for LED B"
	default 18
	help
	  GPIO pin number where LED B is connected.

# --- Synchronization demo ---

config LED_SYNC_ENABLED
	bool "Enable semaphore synchronization demo"
	default y
	help
	  When enabled, the main thread uses a semaphore to synchronize the
	  start of both LED threads. Both threads wait for the semaphore
	  before starting to blink, demonstrating inter-thread synchronization.
	  Disable this to let threads start immediately at boot.

endif # MULTITHREAD_LEDS
```

## prj.conf
```kconfig
# ---------------------------------------------------------------------------
# prj.conf - Multithreaded LED Example Configuration
# ---------------------------------------------------------------------------
# This file sets Kconfig options for the build. Experiment by changing
# values here and rebuilding to see different behaviors!
# ---------------------------------------------------------------------------

# --- Hardware drivers ---
CONFIG_GPIO=y

# --- Console output ---
CONFIG_SERIAL=y
CONFIG_PRINTK=y

# --- Logging subsystem ---
CONFIG_LOG=y

# --- Thread debugging (optional but educational) ---
# Enable thread name tracking (visible in debuggers and logging)
CONFIG_THREAD_NAME=y

# --- Application-specific options (see our Kconfig file) ---
CONFIG_MULTITHREAD_LEDS=y

# Stack size for LED threads
CONFIG_LED_THREAD_STACK_SIZE=1024

# Thread priorities (lower number = higher priority)
# LED A has higher priority (5) than LED B (7)
CONFIG_LED_A_PRIORITY=5
CONFIG_LED_B_PRIORITY=7

# Blink intervals - different values so you can see independent operation
CONFIG_LED_A_BLINK_INTERVAL_MS=500
CONFIG_LED_B_BLINK_INTERVAL_MS=1000

# GPIO pins
CONFIG_LED_A_GPIO_PIN=14
CONFIG_LED_B_GPIO_PIN=18

# Enable semaphore synchronization demo
CONFIG_LED_SYNC_ENABLED=y
```

## src/main.c
```c
/*
 * Multithreaded LED Example - Main Entry Point
 *
 * This example demonstrates core RTOS (Real-Time Operating System) concepts
 * using Zephyr:
 *
 *   1. Threads        - Independent execution contexts with their own stacks
 *   2. Scheduling     - How the kernel decides which thread runs next
 *   3. Priorities     - Higher-priority threads preempt lower-priority ones
 *   4. Semaphores     - Synchronization primitives for coordinating threads
 *   5. K_THREAD_DEFINE - Static (compile-time) thread creation macro
 *   6. Kconfig        - Build-time configuration for all parameters
 *
 * Architecture overview:
 *
 *   +----------------+     gives semaphore     +----------------+
 *   |  Main Thread   | ----------------------> |  LED A Thread  |
 *   |  (boots first) | ---+                    |  (GPIO14, fast)|
 *   +----------------+    |                    +----------------+
 *                         | gives semaphore
 *                         +----------------->  +----------------+
 *                                              |  LED B Thread  |
 *                                              |  (GPIO18, slow)|
 *                                              +----------------+
 *
 * All three threads run concurrently. The main thread signals the LED
 * threads to start via a semaphore, then sleeps indefinitely. Each LED
 * thread blinks its own LED at its own configured interval.
 *
 * Build & flash (replace <board> with your target, e.g. esp_wrover_kit/esp32/procpu):
 *   west build -p -b <board> examples/multithreads_hello_leds --build-dir examples/multithreads_hello_leds/build
 *   west flash --build-dir examples/multithreads_hello_leds/build
 */

#include <zephyr/kernel.h>
#include <zephyr/logging/log.h>

LOG_MODULE_REGISTER(main, LOG_LEVEL_INF);

/* ---------------------------------------------------------------------------
 * Semaphore Declaration
 * ---------------------------------------------------------------------------
 * A semaphore is a synchronization primitive. It has an internal counter:
 *   - k_sem_give() increments the counter (signals)
 *   - k_sem_take() decrements it (waits if counter is 0)
 *
 * Here we use it as a "start gate": both LED threads wait on this semaphore
 * before blinking. The main thread gives it twice (once per thread) to
 * release them. This ensures controlled startup ordering.
 *
 * K_SEM_DEFINE(name, initial_count, max_count)
 *   - initial_count = 0: threads must wait until main signals
 *   - max_count = 1: binary semaphore (only one give() can be pending)
 */
K_SEM_DEFINE(start_sem, 0, 1);

/* ---------------------------------------------------------------------------
 * External Thread Entry Functions
 * ---------------------------------------------------------------------------
 * These functions are defined in separate source files (led_a_thread.c and
 * led_b_thread.c). In Zephyr, all threads share the same address space,
 * so we just need forward declarations here.
 */
void led_a_entry(void *, void *, void *);
void led_b_entry(void *, void *, void *);

/* ---------------------------------------------------------------------------
 * Static Thread Definitions
 * ---------------------------------------------------------------------------
 * K_THREAD_DEFINE creates threads at compile time. This is more efficient
 * than creating threads at runtime with k_thread_create() because the
 * kernel can allocate stacks and thread structures statically.
 *
 * Parameters:
 *   1. Thread ID     - A symbolic name for referencing the thread
 *   2. Stack size    - Bytes of stack memory (from Kconfig)
 *   3. Entry function - The function the thread executes
 *   4-6. Arguments   - Three void* args passed to the entry function
 *   7. Priority      - Thread scheduling priority (from Kconfig)
 *   8. Options       - Thread options (0 = default)
 *   9. Start delay   - Milliseconds before the thread starts (0 = immediate)
 *
 * IMPORTANT: Lower priority NUMBER = Higher scheduling priority.
 *   Priority 5 runs BEFORE priority 7 when both are ready.
 */
K_THREAD_DEFINE(led_a_tid,
	CONFIG_LED_THREAD_STACK_SIZE,
	led_a_entry,
	NULL, NULL, NULL,
	CONFIG_LED_A_PRIORITY,
	0,
	0);

K_THREAD_DEFINE(led_b_tid,
	CONFIG_LED_THREAD_STACK_SIZE,
	led_b_entry,
	NULL, NULL, NULL,
	CONFIG_LED_B_PRIORITY,
	0,
	0);

/* ---------------------------------------------------------------------------
 * main() - Application Entry Point
 * ---------------------------------------------------------------------------
 * The main thread runs after kernel initialization is complete. Here it:
 *   1. Logs a startup message
 *   2. Signals the LED threads to start (via the semaphore)
 *   3. Sleeps forever, yielding CPU time to the LED threads
 *
 * Note: Even though main() loops with k_msleep(), the LED threads are
 * the ones doing the real work. The main thread could also perform
 * periodic tasks (monitoring, watchdog, etc.) in this loop.
 */
int main(void)
{
	LOG_INF("=== Multithreaded LED Example Started ===");
	LOG_INF("LED A: GPIO%d, interval %d ms, priority %d",
		CONFIG_LED_A_GPIO_PIN,
		CONFIG_LED_A_BLINK_INTERVAL_MS,
		CONFIG_LED_A_PRIORITY);
	LOG_INF("LED B: GPIO%d, interval %d ms, priority %d",
		CONFIG_LED_B_GPIO_PIN,
		CONFIG_LED_B_BLINK_INTERVAL_MS,
		CONFIG_LED_B_PRIORITY);

#if CONFIG_LED_SYNC_ENABLED
	/*
	 * Signal both threads to start. Each k_sem_give() releases one
	 * thread that is waiting on k_sem_take(&start_sem, K_FOREVER).
	 * We give twice because two threads are waiting.
	 */
	LOG_INF("Releasing LED threads via semaphore...");
	k_sem_give(&start_sem);
	k_sem_give(&start_sem);
#endif

	/* Main thread has nothing else to do - sleep forever */
	while (1) {
		k_msleep(10000);
	}

	return 0;
}
```

## src/led_a_thread.c
```c
/*
 * LED A Thread - Blinks LED on GPIO pin A
 *
 * This thread demonstrates:
 *   - Waiting on a semaphore before starting work
 *   - Independent GPIO control within a thread context
 *   - Using Kconfig values for all configurable parameters
 */

#include <zephyr/kernel.h>
#include <zephyr/drivers/gpio.h>
#include <zephyr/logging/log.h>

LOG_MODULE_REGISTER(led_a, LOG_LEVEL_INF);

/* The start semaphore is defined in main.c */
extern struct k_sem start_sem;

/*
 * led_a_entry() - Thread entry point for LED A
 *
 * The three void* parameters are passed from K_THREAD_DEFINE. We don't
 * use them in this example (they are NULL), but they can be used to pass
 * configuration data to threads when using k_thread_create() at runtime.
 */
void led_a_entry(void *p1, void *p2, void *p3)
{
	const struct device *gpio_dev = DEVICE_DT_GET(DT_NODELABEL(gpio0));

	if (!device_is_ready(gpio_dev)) {
		LOG_ERR("GPIO device not ready");
		return;
	}

	int ret = gpio_pin_configure(gpio_dev, CONFIG_LED_A_GPIO_PIN,
				     GPIO_OUTPUT_ACTIVE);
	if (ret < 0) {
		LOG_ERR("Failed to configure GPIO%d (error %d)",
			CONFIG_LED_A_GPIO_PIN, ret);
		return;
	}

#if CONFIG_LED_SYNC_ENABLED
	/*
	 * Wait for the main thread to give the semaphore.
	 * K_FOREVER means "block indefinitely until the semaphore is available".
	 * The thread is in WAITING state during this time and consumes no CPU.
	 */
	LOG_INF("LED A waiting for start signal...");
	k_sem_take(&start_sem, K_FOREVER);
#endif

	LOG_INF("LED A thread running (GPIO%d, every %d ms)",
		CONFIG_LED_A_GPIO_PIN, CONFIG_LED_A_BLINK_INTERVAL_MS);

	bool state = true;

	while (1) {
		gpio_pin_toggle(gpio_dev, CONFIG_LED_A_GPIO_PIN);
		state = !state;
		LOG_INF("LED A (GPIO%d): %s", CONFIG_LED_A_GPIO_PIN,
			state ? "ON" : "OFF");
		k_msleep(CONFIG_LED_A_BLINK_INTERVAL_MS);
	}
}
```

## src/led_b_thread.c
```c
/*
 * LED B Thread - Blinks LED on GPIO pin B
 *
 * This thread is structurally identical to LED A but uses different
 * Kconfig settings (pin, interval, priority). This demonstrates how
 * the same logic can run in parallel with different configurations -
 * a common pattern in RTOS applications (e.g., multiple sensor readers,
 * multiple communication channels).
 */

#include <zephyr/kernel.h>
#include <zephyr/drivers/gpio.h>
#include <zephyr/logging/log.h>

LOG_MODULE_REGISTER(led_b, LOG_LEVEL_INF);

/* The start semaphore is defined in main.c */
extern struct k_sem start_sem;

void led_b_entry(void *p1, void *p2, void *p3)
{
	const struct device *gpio_dev = DEVICE_DT_GET(DT_NODELABEL(gpio0));

	if (!device_is_ready(gpio_dev)) {
		LOG_ERR("GPIO device not ready");
		return;
	}

	int ret = gpio_pin_configure(gpio_dev, CONFIG_LED_B_GPIO_PIN,
				     GPIO_OUTPUT_ACTIVE);
	if (ret < 0) {
		LOG_ERR("Failed to configure GPIO%d (error %d)",
			CONFIG_LED_B_GPIO_PIN, ret);
		return;
	}

#if CONFIG_LED_SYNC_ENABLED
	LOG_INF("LED B waiting for start signal...");
	k_sem_take(&start_sem, K_FOREVER);
#endif

	LOG_INF("LED B thread running (GPIO%d, every %d ms)",
		CONFIG_LED_B_GPIO_PIN, CONFIG_LED_B_BLINK_INTERVAL_MS);

	bool state = true;

	while (1) {
		gpio_pin_toggle(gpio_dev, CONFIG_LED_B_GPIO_PIN);
		state = !state;
		LOG_INF("LED B (GPIO%d): %s", CONFIG_LED_B_GPIO_PIN,
			state ? "ON" : "OFF");
		k_msleep(CONFIG_LED_B_BLINK_INTERVAL_MS);
	}
}
```
