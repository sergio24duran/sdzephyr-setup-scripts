## CMakeLists.txt
```
# ---------------------------------------------------------------------------
# CMakeLists.txt - Build System Configuration
# ---------------------------------------------------------------------------
# Zephyr uses CMake as its build system. This file tells CMake:
#   1. The minimum CMake version required
#   2. To find and load the Zephyr build system
#   3. The project name
#   4. Which source files to compile
#
# The Zephyr CMake package automatically handles:
#   - Cross-compilation toolchain setup
#   - Linking against the Zephyr kernel and enabled libraries
#   - Processing Kconfig options and devicetree overlays
# ---------------------------------------------------------------------------

cmake_minimum_required(VERSION 3.20.0)

# Find the Zephyr package. ZEPHYR_BASE env variable must point to the
# Zephyr repository (set automatically by "west build" or "source zephyr-env.sh")
find_package(Zephyr REQUIRED HINTS $ENV{ZEPHYR_BASE})

project(hello_led)

# Add application source files to the "app" target (provided by Zephyr)
target_sources(app PRIVATE src/main.c)
```

## Kconfig
```
# Copyright (c) 2024 SDZephyr
# SPDX-License-Identifier: Apache-2.0

# ---------------------------------------------------------------------------
# Kconfig - Kernel Configuration System
# ---------------------------------------------------------------------------
# Kconfig is the configuration system used by Zephyr (inherited from the
# Linux kernel). It allows you to define build-time options that can be
# enabled/disabled or given values in your prj.conf file.
#
# Key concepts:
#   - Each option is prefixed with CONFIG_ when used in code or prj.conf
#   - Options can have types: bool, int, string, hex
#   - Options can have defaults, dependencies (depends on), and auto-selects
#   - "menuconfig" groups options under a collapsible menu in graphical tools
#
# IMPORTANT: When an application provides its own Kconfig file, Zephyr uses
# it as the ROOT of the entire Kconfig tree. This means we MUST source
# "Kconfig.zephyr" here to include all of Zephyr's own configuration symbols
# (GPIO, LOG, SERIAL, etc.). Without this line, those symbols are undefined
# and the build will fail with "attempt to assign value to undefined symbol".
#
# To explore all available options interactively, run:
#   west build -t menuconfig
# ---------------------------------------------------------------------------

mainmenu "Hello LED Example"

# Pull in the full Zephyr Kconfig tree (kernel + all drivers + subsystems).
# This MUST come before any application-specific options that depend on or
# select Zephyr symbols (e.g. "select LOG").
source "Kconfig.zephyr"

menuconfig HELLO_LED
	bool "Hello LED Example Configuration"
	default y
	help
	  Enable configuration options for the Hello LED example.
	  This demonstrates how to use Kconfig to make your application
	  configurable at build time.

if HELLO_LED

config HELLO_LED_BLINK_INTERVAL_MS
	int "LED blink interval in milliseconds"
	default 1000
	range 100 10000
	help
	  Time in milliseconds between LED state toggles.
	  A smaller value makes the LED blink faster.
	  Valid range: 100ms to 10000ms (10 seconds).

config HELLO_LED_GPIO_PIN
	int "GPIO pin number for the LED"
	default 14
	help
	  The GPIO pin number where the LED is connected.
	  Default is GPIO14 (common on ESP32 boards). Change this to match
	  your hardware — e.g. 13 for many Arduino-style boards, or check
	  your board's documentation for available GPIO pins.

config HELLO_LED_LOG_ENABLED
	bool "Enable logging output"
	default y
	select LOG
	help
	  When enabled, the application prints the LED state to the console
	  on every toggle. Disable this to reduce code size and overhead.

endif # HELLO_LED
```

## prj.conf
```kconfig
# ---------------------------------------------------------------------------
# prj.conf - Project Configuration File
# ---------------------------------------------------------------------------
# This file sets Kconfig options for the build. Every line here overrides the
# default value defined in a Kconfig file. The CONFIG_ prefix maps directly
# to the Kconfig symbol name.
#
# TIP: Run "west build -t menuconfig" to explore ALL available options
# in an interactive menu (requires the 'menuconfig' package).
# ---------------------------------------------------------------------------

# --- Hardware drivers ---
# Enable the GPIO subsystem (required to control LED pins)
CONFIG_GPIO=y

# --- Console / serial output ---
# Enable the serial (UART) driver so we can see printf/printk output
CONFIG_SERIAL=y
# Enable printk(), Zephyr's lightweight kernel-level print function
CONFIG_PRINTK=y

# --- Logging subsystem ---
# Enable Zephyr's structured logging framework (used by LOG_INF, LOG_ERR, etc.)
CONFIG_LOG=y

# --- Application-specific options (defined in our Kconfig file) ---
# Enable the Hello LED configuration block
CONFIG_HELLO_LED=y
# Blink every 1000 ms (1 second). Try changing this to 200 for fast blink!
CONFIG_HELLO_LED_BLINK_INTERVAL_MS=1000
# GPIO pin where the LED is connected
CONFIG_HELLO_LED_GPIO_PIN=14
# Enable log messages showing LED state on each toggle
CONFIG_HELLO_LED_LOG_ENABLED=y
```

## src/main.c
```c
/*
 * Hello LED - Blinky Example for Zephyr RTOS
 *
 * This is a minimal "Hello World" for embedded systems: blinking an LED.
 * It demonstrates several fundamental Zephyr concepts:
 *
 *   1. GPIO driver API    - How to configure and control hardware pins
 *   2. Kernel sleep       - How to yield the CPU using k_msleep()
 *   3. Kconfig options    - How build-time configuration controls behavior
 *   4. Logging subsystem  - How to use Zephyr's structured logging (LOG_INF)
 *   5. Main thread        - The entry point that Zephyr calls after boot
 *
 * Hardware: Any board with a GPIO-connected LED (ESP32, nRF52, STM32, etc.)
 * Default pin: GPIO14 (configurable via CONFIG_HELLO_LED_GPIO_PIN)
 *
 * Build & flash (replace <board> with your target, e.g. esp_wrover_kit/esp32/procpu):
 *   west build -p -b <board> examples/hello_led --build-dir examples/hello_led/build
 *   west flash --build-dir examples/hello_led/build
 */

#include <zephyr/kernel.h>       /* k_msleep, kernel types              */
#include <zephyr/drivers/gpio.h> /* GPIO driver API                     */
#include <zephyr/logging/log.h>  /* Structured logging (LOG_INF, etc.)  */

/* ---------------------------------------------------------------------------
 * Logging Module Registration
 * ---------------------------------------------------------------------------
 * LOG_MODULE_REGISTER creates a named logging module with a default level.
 * The first argument is the module name (appears in log output).
 * The second argument is the default log level:
 *   - LOG_LEVEL_NONE  (0) - No logging
 *   - LOG_LEVEL_ERR   (1) - Only errors
 *   - LOG_LEVEL_WRN   (2) - Errors and warnings
 *   - LOG_LEVEL_INF   (3) - Errors, warnings, and informational messages
 *   - LOG_LEVEL_DBG   (4) - All messages including debug
 */
LOG_MODULE_REGISTER(hello_led, LOG_LEVEL_INF);

/* ---------------------------------------------------------------------------
 * Kconfig-driven Configuration
 * ---------------------------------------------------------------------------
 * These values come from Kconfig (see the Kconfig file in this directory).
 * They are set in prj.conf and become compile-time constants.
 * The CONFIG_ prefix is added automatically by the Kconfig system.
 */
#define BLINK_INTERVAL_MS  CONFIG_HELLO_LED_BLINK_INTERVAL_MS
#define LED_PIN            CONFIG_HELLO_LED_GPIO_PIN

/* GPIO output flags: start with the pin driven HIGH (LED on) */
#define LED_FLAGS          GPIO_OUTPUT_ACTIVE

/* ---------------------------------------------------------------------------
 * main() - Application Entry Point
 * ---------------------------------------------------------------------------
 * In Zephyr, main() runs in the "main thread" which is automatically created
 * by the kernel at boot. This thread has a default priority and stack size
 * defined in the kernel configuration. Unlike bare-metal programs, main()
 * runs within the RTOS scheduler, so calling k_msleep() yields the CPU to
 * other threads (if any) rather than busy-waiting.
 */
int main(void)
{
	int ret;
	bool led_state = true;

	/*
	 * Get the GPIO port device.
	 * DEVICE_DT_GET retrieves a device pointer from the devicetree.
	 * DT_NODELABEL(gpio0) refers to the node labeled "gpio0" in the
	 * board's devicetree. Most boards define gpio0 as the main GPIO port.
	 */
	const struct device *gpio_dev = DEVICE_DT_GET(DT_NODELABEL(gpio0));

	if (!device_is_ready(gpio_dev)) {
		LOG_ERR("GPIO device is not ready - check your board configuration");
		return -1;
	}

	/*
	 * Configure the pin as a digital output.
	 * GPIO_OUTPUT_ACTIVE means the pin starts HIGH (LED on).
	 * This function returns 0 on success or a negative error code.
	 */
	ret = gpio_pin_configure(gpio_dev, LED_PIN, LED_FLAGS);
	if (ret < 0) {
		LOG_ERR("Failed to configure GPIO pin %d (error %d)", LED_PIN, ret);
		return ret;
	}

	LOG_INF("Hello LED started - blinking GPIO%d every %d ms",
		LED_PIN, BLINK_INTERVAL_MS);

	/*
	 * Main loop - runs forever.
	 * In an RTOS, the main thread typically never exits. If it did,
	 * the kernel would continue running other threads (if any).
	 */
	while (1) {
		/* Toggle the LED pin (HIGH -> LOW or LOW -> HIGH) */
		gpio_pin_toggle(gpio_dev, LED_PIN);
		led_state = !led_state;

#if CONFIG_HELLO_LED_LOG_ENABLED
		LOG_INF("LED state: %s", led_state ? "ON" : "OFF");
#endif
		/*
		 * k_msleep() puts the current thread to sleep for the given
		 * number of milliseconds. During this time, the CPU is free
		 * to execute other threads. This is fundamentally different
		 * from a busy-wait delay and is a core RTOS concept.
		 */
		k_msleep(BLINK_INTERVAL_MS);
	}

	return 0; /* Never reached, but satisfies the C standard */
}
```
